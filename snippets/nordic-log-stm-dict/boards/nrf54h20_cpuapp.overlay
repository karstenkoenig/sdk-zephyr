/*
 * Copyright (c) 2024 Nordic Semiconductor
 * SPDX-License-Identifier: Apache-2.0
 */
#include <zephyr/dt-bindings/misc/nordic-tddconf.h>

&tbm {
	status = "okay";
};

&tddconf {
	status = "okay";
	etrsources = <NRF_TDDCONF_SOURCE_STMMAINCORE>;
	portconfig = <0>;
};
