## dts/bindings/arm/nordic,nrf-tddconf.yaml
```yaml
# Copyright (c) 2024 Nordic Semiconductor ASA
# SPDX-License-Identifier: Apache-2.0

description: |
  Nordic TRACE and Debug Domain

  Configuration for the Trace and Debug subsystem

compatible: "nordic,nrf-tddconf"

include: base.yaml

properties:
  stmsink:
    deprecated: true
    type: string
    description: indicates the sink for STM data
    enum:
      - "etr"
      - "tpiu"
      # - "etb" - Not supported yet

  etbsources:
    type: int
    description: Bitmask of enabled sources for the ETB sink.

  tpiusources:
    type: int
    description: Bitmask of enabled sources for the TPIU sink.

  etrsources:
    type: int
    description: Bitmask of enabled sources for the ETR sink.

  portconfig:
    type: int
    description: TPIU clock divider - TDD HSFLL / 2^(2 + portconfig)
    enum:
      - 0
      - 1
      - 2
      - 3
```
